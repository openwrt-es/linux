## Documentation/devicetree/bindings/hwmon/sfr,neufbox6.yaml
```yaml
# SPDX-License-Identifier: GPL-2.0-or-later
%YAML 1.2
---
$id: http://devicetree.org/schemas/hwmon/sfr,neufbox6.yaml#
$schema: http://devicetree.org/meta-schemas/core.yaml#

title: SFR NeufBox 6 Sensor

maintainers:
  - Álvaro Fernández Rojas <noltari@gmail.com>

description: |
  SFR NeufBox 6 is equipped with an I2C connected chip to monitor voltage,
  temperature and other stats. It also has PWM LEDs that can be manually
  controlled or set to specific hardware monitoring modes.

properties:
  compatible:
    const: sfr,nb6_hwmon

  reg:
    description: I2C address
    maxItems: 1

required:
  - compatible
  - reg

additionalProperties: false

examples:
  - |
    pwm: hwmon@60 {
      compatible = "sfr,nb6_hwmon";
      reg = <0x60>;
    };

    pwm-leds {
      compatible = "pwm-leds";

      service1_red {
        label = "neufbox-6-foxconn-r0:red:service1";
        pwms = <&pwm 0 31>;
        max-brightness = <31>;
      };

      service2_red {
        label = "neufbox-6-foxconn-r0:red:service2";
        pwms = <&pwm 1 31>;
        max-brightness = <31>;
      };

      service3_red {
        label = "neufbox-6-foxconn-r0:red:service3";
        pwms = <&pwm 2 31>;
        max-brightness = <31>;
      };

      service1_green {
        label = "neufbox-6-foxconn-r0:green:service1";
        pwms = <&pwm 3 31>;
        max-brightness = <31>;
        default-state = "on";
      };

      service2_green {
        label = "neufbox-6-foxconn-r0:green:service2";
        pwms = <&pwm 4 31>;
        max-brightness = <31>;
      };

      service3_green {
        label = "neufbox-6-foxconn-r0:green:service3";
        pwms = <&pwm 5 31>;
        max-brightness = <31>;
      };

      wan_white {
        label = "neufbox-6-foxconn-r0:white:wan";
        pwms = <&pwm 6 31>;
        max-brightness = <31>;
      };

      voip_white {
        label = "neufbox-6-foxconn-r0:white:voip";
        pwms = <&pwm 7 31>;
        max-brightness = <31>;
      };

      wlan_white {
        label = "neufbox-6-foxconn-r0:white:wlan";
        pwms = <&pwm 8 31>;
        max-brightness = <31>;
      };
    };
...
```

## Documentation/devicetree/bindings/interrupt-controller/brcm,bcm6345-ext-intc.yaml
```yaml
# SPDX-License-Identifier: (GPL-2.0-only OR BSD-2-Clause)
%YAML 1.2
---
$id: http://devicetree.org/schemas/interrupt-controller/brcm,bcm6345-ext-intc.yaml#
$schema: http://devicetree.org/meta-schemas/core.yaml#

title: Broadcom BCM6345 external interrupt controller

maintainers:
  - Álvaro Fernández Rojas <noltari@gmail.com>
  - Jonas Gorski <jonas.gorski@gmail.com>

properties:
  compatible:
    enum:
      - brcm,bcm6318-ext-intc
      - brcm,bcm6345-ext-intc

  "#interrupt-cells":
    const: 2

  reg:
    maxItems: 1

  "#address-cells":
    const: 0

  interrupt-controller: true

  interrupts:
    description: Specifies the interrupt line(s) in the interrupt-parent
      controller node. Valid values depend on the type of parent interrupt
      controller.
    maxItems: 4

  brcm,field-width:
    description: Interrupt controller field width (the default is 4).
    maxItems: 1
    $ref: /schemas/types.yaml#/definitions/uint32

required:
  - "#address-cells"
  - compatible
  - reg
  - "#interrupt-cells"
  - interrupt-controller
  - interrupts

additionalProperties: false

examples:
  - |
    interrupt-controller@10000018 {
      #address-cells = <0>;
      compatible = "brcm,bcm6345-ext-intc";
      reg = <0x10000018 0x4>;

      interrupt-parent = <&periph_intc>;
      #interrupt-cells = <2>;

      interrupt-controller;
      interrupts = <24>, <25>, <26>, <27>;
    };

  - |
    interrupt-controller@fffe0014 {
      #address-cells = <0>;
      compatible = "brcm,bcm6345-ext-intc";
      reg = <0xfffe0014 0x4>;

      interrupt-controller;
      #interrupt-cells = <2>;

      interrupt-parent = <&cpu_intc>;
      interrupts = <3>, <4>, <5>, <6>;

      brcm,field-width = <5>;
    };
```

## Documentation/devicetree/bindings/pci/brcm,bcm6328-pcie.yaml
```yaml
# SPDX-License-Identifier: (GPL-2.0-only OR BSD-2-Clause)
%YAML 1.2
---
$id: http://devicetree.org/schemas/pci/brcm,bcm6328-pcie.yaml#
$schema: http://devicetree.org/meta-schemas/core.yaml#

title: BCM6328 PCIe Host Controller Device Tree Bindings

maintainers:
  - Álvaro Fernández Rojas <noltari@gmail.com>

allOf:
  - $ref: /schemas/pci/pci-bus.yaml#

properties:
  compatible:
    enum:
     - brcm,bcm6328-pcie
     - brcm,bcm6362-pcie
     - brcm,bcm63268-pcie

  clocks:
    maxItems: 1

  clock-names:
    items:
      - const: pcie

  "#interrupt-cells":
    const: 1

  interrupt-map-mask:
    maxItems: 1

  interrupt-map:
    maxItems: 1

  power-domains:
    maxItems: 1

  ranges:
    maxItems: 1

  reg:
    maxItems: 1

  resets:
    maxItems: 4

  reset-names:
    items:
      - const: pcie
      - const: pcie-core
      - const: pcie-ext
      - const: pcie-hard

required:
  - brcm,serdes
  - clocks
  - clock-names
  - "#interrupt-cells"
  - interrupt-map-mask
  - interrupt-map
  - ranges
  - reg
  - resets
  - reset-names

unevaluatedProperties: false

examples:
  - |
    serdes_cntl: syscon@10001800 {
      compatible = "syscon";
      reg = <0x10001800 0x4>;
      native-endian;
    };

    pcie: pcie@10e40000 {
      compatible = "brcm,bcm6328-pcie";
      reg = <0x10e40000 0x10000>;
      #address-cells = <3>;
      #size-cells = <2>;

      device_type = "pci";
      bus-range = <0x00 0x01>;
      ranges = <0x2000000 0 0x10f00000 0x10f00000 0 0x100000>;
      linux,pci-probe-only = <1>;

      #interrupt-cells = <1>;
      interrupt-map-mask = <0 0 0 0>;
      interrupt-map = <0 0 0 0 &periph_intc BCM6328_IRQ_PCIE_RC 0>;

      clocks = <&periph_clk BCM6328_CLK_PCIE>;
      clock-names = "pcie";

      resets = <&periph_rst BCM6328_RST_PCIE>,
               <&periph_rst BCM6328_RST_PCIE_EXT>,
               <&periph_rst BCM6328_RST_PCIE_CORE>,
               <&periph_rst BCM6328_RST_PCIE_HARD>;
      reset-names = "pcie",
                    "pcie-ext",
                    "pcie-core",
                    "pcie-hard";

      power-domains = <&periph_pwr BCM6328_POWER_DOMAIN_PCIE>;

      brcm,serdes = <&serdes_cntl>;
    };
```
